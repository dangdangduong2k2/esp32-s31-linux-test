// SPDX-License-Identifier: MIT
// Generated by led/build-overlay.py; do not edit separately.
/dts-v1/;
/plugin/;

/ {
    espressif,overlay-name = "rgb-led";
    espressif,resource-claims = "gpspi2";
    fragment@0 {
        target = <0xffffffff>;
        __overlay__ {
            status = "okay";
        };
    };
    fragment@1 {
        target = <0xffffffff>;
        __overlay__ {
            spi-pins {
                espressif,route-names = "rgb-led.data";
                espressif,route-kinds = "matrix-output";
                pinmux = <0x1000373c>;
            };
        };
    };
    fragment@2 {
        target = <0xffffffff>;
        __overlay__ {
            #address-cells = <0x1>;
            #size-cells = <0x0>;
            status = "okay";
            spidev@0 {
                compatible = "rohm,dh2228fv";
                reg = <0x0>;
                spi-max-frequency = <0x30d400>;
            };
        };
    };
    __fixups__ {
        axi_gdma = "/fragment@0:target:0";
        gpspi2_default = "/fragment@1:target:0";
        gpspi2 = "/fragment@2:target:0";
    };
};
